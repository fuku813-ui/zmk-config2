/ {
    chosen {
        zmk,kscan = &kscan0;
    };
};

&pro_micro { }; /* ダミー（無視されます） */

/* キースキャン定義 */
kscan0: kscan {
    compatible = "zmk,kscan-gpio-matrix";
    diode-direction = <COL2ROW>;

    /* 行 (ROWS) */
    row-gpios = <&gpio0  3  (GPIO_ACTIVE_HIGH | GPIO_PULL_DOWN)>,
                <&gpio0 28  (GPIO_ACTIVE_HIGH | GPIO_PULL_DOWN)>,
                <&gpio0 29  (GPIO_ACTIVE_HIGH | GPIO_PULL_DOWN)>,
                <&gpio1 11  (GPIO_ACTIVE_HIGH | GPIO_PULL_DOWN)>;

    /* 列 (COLS) */
    col-gpios = <&gpio1 15 GPIO_ACTIVE_HIGH>,
                <&gpio1 14 GPIO_ACTIVE_HIGH>,
                <&gpio1 13 GPIO_ACTIVE_HIGH>,
                <&gpio1 12 GPIO_ACTIVE_HIGH>,
                <&gpio0  9 GPIO_ACTIVE_HIGH>; /* NFC1 → confでGPIO化 */
};

