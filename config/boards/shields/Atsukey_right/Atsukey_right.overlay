/ {
    chosen {
        /* ZMK が使うキースキャンノードを指定 */
        zmk,kscan = &kscan0;
    };

    /* ここからが kscan ノード本体（root の中に置く） */
    kscan0: kscan {
        compatible = "zmk,kscan-gpio-matrix";
        diode-direction = <COL2ROW>;

        /* 行 (ROWS): P0.03, P0.28, P0.29, P1.11 */
        row-gpios = <&gpio0  3  GPIO_ACTIVE_HIGH>,
                    <&gpio0 28  GPIO_ACTIVE_HIGH>,
                    <&gpio0 29  GPIO_ACTIVE_HIGH>,
                    <&gpio1 11  GPIO_ACTIVE_HIGH>;

        /* 列 (COLS): P1.15, P1.14, P1.13, P1.12, P0.09(NFC1) */
        col-gpios = <&gpio1 15 GPIO_ACTIVE_HIGH>,
                    <&gpio1 14 GPIO_ACTIVE_HIGH>,
                    <&gpio1 13 GPIO_ACTIVE_HIGH>,
                    <&gpio1 12 GPIO_ACTIVE_HIGH>,
                    <&gpio0  9 GPIO_ACTIVE_HIGH>;
    };
};
